/*
 * Control-map test E:
 *   CS=D8/P1.04, DC=D9/P1.06, RST=D16/P0.10, BUSY=D10/P0.09
 *
 * SPDX-License-Identifier: MIT
 */

&spi0 {
    cs-gpios = <&gpio1 4 GPIO_ACTIVE_LOW>;
};

&epd {
    dc-gpios = <&gpio1 6 GPIO_ACTIVE_LOW>;
    reset-gpios = <&gpio0 10 GPIO_ACTIVE_LOW>;
    busy-gpios = <&gpio0 9 GPIO_ACTIVE_LOW>;
};
